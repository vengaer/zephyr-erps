## dts/bindings/ethernet/itu-t,erps-node.yaml
```yaml
# Copyright (c) 2026 Vilhelm Engström
#
# SPDX-License-Identifier: Apache-2.0

description: |
  ERPS (ITU-T G.8032) node

compatible: itu-t,erps-node

properties:
  itu-t,ring-protection-link:
    type: phandle
    description: |
      Set to mark this node as a ring protection link. The property being set
      marks the device as either the RPL owner or the RPL neighbor. Which of the
      two is determined by the presence the itu-t,rpl-owner property.

      Each Ethernet ring should have a single ring protection link.

  itu-t,ring-links:
    type: phandles
    required: true
    description: |
      A phandles array referring to devices representing regular ring links. These
      may be switch ports or MACs.

  itu-t,rpl-owner:
    type: boolean
    description: |
      Set for nodes managing the ring protection link. Requires that the
      itu-t,ring-protection-link property is set.

      Nodes marked with this property serve the roll of ETH_C_MI_RAPS_RPL_Owner_Node
      described in the ERPS specification. If said property is not set but the
      itu-t,ring-protection-lin property is set, the node takes on the role of what in
      the specification is referred to as the ETH_C_MI_RAPS_RPL_Neighbour_Node.

  itu-t,non-revertive:
    type: boolean
    description: |
      By default, traffic is automatically reverted to the original path when a failed
      link is restored. Setting this property causes traffic to be routed through the RPL
      even after the link is restored. Note that setting this property DOES NOT cause the
      restored link to be treated as an RPL.

      Corresponds to the inverse of ETH_C_MI_RAPS_Revertive in the specification.

  itu-t,raps-version:
    type: int
    default: 1
    description: |
      R-APS version. Use the macros in include/zephyr/dt-bindings/ethernet/erps.h.
    enum:
      - 0
      - 1

  itu-t,ring-id:
    type: int
    required: true
    description: |
      Numeric idenfier of the Ethernet ring to which this node belongs.
    min: 1
    max: 239

  itu-t,vlan-identifier:
    type: int
    default: 4093
    description: |
      VLAN identifier used for the ring network

  itu-t,net-pkt-alloc-timeout:
    type: int
    default: 50
    description: |
      Allocation timeout for outgoing net_pkt instances, in ms.

  itu-t,raps-mel:
    type: int
    default: 7
    description: |
      The maintenance entity group level determines whether or not R-APS PDUs are
      forwarded on networks with other fault detection protocols enabled. If the R-APS
      MEL is lower than that of other fault detection protocols, the R-APS PDUs are
      discarded.
    enum:
      - 0
      - 1
      - 2
      - 3
      - 4
      - 5
      - 6
      - 7

  itu-t,guard-timer-duration:
    type: int
    default: 500
    description: |
      Number of milliseconds before the guard timer expires.

  itu-t,wtr-timer-duration:
    type: int
    default: 5
    description: |
      Wait-to-restore timer duration, in minutes.
    enum:
      - 1
      - 2
      - 3
      - 4
      - 5
      - 6
      - 7
      - 8
      - 9
      - 10
      - 11
      - 12

examples: |
  - /* Ring node A, RPL owner */
    / {

      ethernet-ring0 {
        compatible = "itu-t,erps-node";

        /* Port 1 is RPL */
        itu-t,ring-protection-link = <&sw1_port1>;

        /* Port 2 is non-RPL */
        itu-t,ring-links = <&sw1_port2>;

        /* This node is managing the RPL */
        itu-t,rpl-owner;

        /* Use the same ID as in nodes B and C */
        itu-t,ring-id = <1>;

        status = "okay";
      };
    };

    /* Ethernet switch */
    &sw1 {
      status = "okay";

      /* Connected to sw1_port1 on ring node B */
      sw1_port1: port@0 {
        compatible = "zephyr,dsa-port;"
        reg = <0>;

        /* DSA stuff... */
        status = "okay";
      };

      /* Connected to sw1_port2 on ring node C */
      sw1_port2: port@1 {
        compatible = "zephyr,dsa-port";
        reg = <1>;

        /* DSA stuff... */

        status = "okay";
    };
  };

  - /* Ring node B, RPL neighbor */
    / {

      ethernet-ring0 {
        compatible = "itu-t,erps-node";

        /* Port 1 is RPL */
        itu-t,ring-protection-link = <&sw1_port1>;

        /* Port 2 is non-RPL */
        itu-t,ring-links = <&sw1_port2>;

        /* This node is the RPL neighbor, leave the itu-t,rpl-owner property unset */

        /* Use the same ID as in nodes A and C */
        itu-t,ring-id = <1>;

        status = "okay";
      };
    };

    /* Ethernet switch */
    &sw1 {
      status = "okay";

      /* Connected to sw1_port1 on node A */
      sw1_port1: port@0 {
        compatible = "zephyr,dsa-port;"
        reg = <0>;

        /* DSA stuff... */
        status = "okay";
      };

      /* Connected to sw1_port1 on node C */
      sw1_port2: port@1 {
        compatible = "zephyr,dsa-port";
        reg = <1>;

        /* DSA stuff... */

        status = "okay";
    };
  };

  - /* Ring node C, simple node */
    / {

      ethernet-ring0 {
        compatible = "itu-t,erps-node";

        /* Node is not connected to the RPL, leave itu-t,ring-protection-link unset */

        /* Both links are non-RPLs */
        itu-t,ring-links = <&sw1_port1 &sw1_port2>;

        /* Use the same ID as in nodes A and B */
        itu-t,ring-id = <1>;

        status = "okay";
      };
    };

    /* Ethernet switch */
    &sw1 {
      status = "okay";

      /* Connected to sw1_port2 on node B */
      sw1_port1: port@0 {
        compatible = "zephyr,dsa-port;"
        reg = <0>;

        /* DSA stuff... */
        status = "okay";
      };

      /* Connected to sw1_port2 on node A */
      sw1_port2: port@1 {
        compatible = "zephyr,dsa-port";
        reg = <1>;

        /* DSA stuff... */

        status = "okay";
    };
  };
```

## subsys/net/Kconfig
```kconfig
# Copyright (c) 2026 Vilhelm Engström
#
# SPDX-License-Identifier: Apache-2.0

rsource "l2/Kconfig"
```

## subsys/net/l2/ethernet/erps/Kconfig
```kconfig
# Copyright (c) 2026 Vilhelm Engström
#
# SPDX-License-Identifier: Apache-2.0

menu "Ethernet Ring Protection Switching"

config NET_ERPS
	bool "Ethernet ring protection switching"
	default y
	depends on DT_HAS_ITU_T_ERPS_NODE_ENABLED && NETWORKING
	select NET_VLAN
	select NET_L2_ETHERNET_MGMT
	help
	  Ethernet ring protection switching provides recovery switching
	  for Ethernet rings while ensuring there are no loops in the
	  network. Select y to enable this feature.

if NET_ERPS

config NET_ERPS_INIT_PRIORITY
	int "ERPS initialization priority"
	default 92
	help
	  ERPS link initialization priority.

config NET_ERPS_SHELL
	bool "ERPS administration from the shell"
	select NET_SHELL
	select SHELL_HELP
	help
	  Set to gain access to the erps shell subcommands.

config NET_ERPS_PAD_RAPS_PDUS
	bool "Pad R-APS PDUs"
	default y
	help
	  Standard R-APS frames are 55 octets, i.e. smaller than the minimum size 64 byte Ethernet
	  frame. Such small frames - so called runt frames - are automatically dropped by network
	  devices.

	  Enabling this option causes the ERPS implementation to automatically pad each PDU to 60
	  bytes, avoiding it being dropped by network devices once the 4 byte CRC has been appended.

	  Say n only if your MAC is configured to to pad runt frames.

config NET_ERPS_LINK_FAIL_TIMEOUT
	int "Number of milliseconds to wait before assuming a link is severed at startup"
	default 10000
	help
	  Since a severed link will not generate a carrier down event, the ERPS implementation
	  uses a timer started at boot to determine whether or not a link disrupted. This option
	  determines the timeout of said timer.

	  Reducing the value of this option results in the ring detecting links that are alread
	  broken at startup at a faster rate. Reducing it too much will cause the ERPS core to
	  mistake links as severed at startup.

module = NET_ERPS
module-str = erps
source "subsys/logging/Kconfig.template.log_config"

endif

endmenu
```
